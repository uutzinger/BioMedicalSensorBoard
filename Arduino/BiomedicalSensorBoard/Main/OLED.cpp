/******************************************************************************************************/
// OLED
/******************************************************************************************************/
#include "CommonDefs.h"
#include "OLED.h"
#include "ECG.h"
#include "Print.h"
#include "Config.h"
#include "Battery.h"

bool          oled_avail;                      // we have OLED electronics

Adafruit_SSD1306     display(OLED_RESET);

const unsigned char Battery_100 [] = {
0x00, 0x00, 0x00, 0x00, 0x00, 0x00, 0x00, 0x00, 0x00, 0x00, 0x00, 0x00, 0x00, 0x00, 0x00, 0x00,
0x00, 0x00, 0x00, 0x00, 0x00, 0x00, 0x00, 0x00, 0x00, 0x00, 0x00, 0x00, 0x00, 0x00, 0x00, 0x00,
0x00, 0x00, 0x00, 0x00, 0x3F, 0xFF, 0xFF, 0xF0, 0x40, 0x00, 0x00, 0x10, 0x47, 0x3C, 0xE7, 0x18,
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0x00, 0x00, 0x00, 0x00, 0x00, 0x00, 0x00, 0x00, 0x00, 0x00, 0x00, 0x00, 0x00, 0x00, 0x00, 0x00
};

const unsigned char ECG_Disp [] = {
0x00, 0x00, 0x00, 0x00, 0x00, 0x00, 0x00, 0x00, 0x00, 0x00, 0x00, 0x00, 0x00, 0x00, 0x00, 0x00, 
0x00, 0x00, 0x80, 0x00, 0x00, 0x00, 0x80, 0x00, 0x00, 0x00, 0x80, 0x00, 0x00, 0x00, 0x80, 0x00, 
0x00, 0x00, 0x80, 0x00, 0x00, 0x00, 0x80, 0x00, 0x00, 0x00, 0x80, 0x00, 0x00, 0x00, 0x80, 0x00, 
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0x00, 0x00, 0x20, 0x00, 0x00, 0x00, 0x00, 0x00, 0x00, 0x00, 0x00, 0x00, 0x00, 0x00, 0x00, 0x00
};

bool initializeOLED() {
  bool ok;
  LOG_Dln("D:I:OLED:..");

  // create display voltage from internal 3.3V
  if(!display.begin(SSD1306_SWITCHCAPVCC, 0x3C)) { 
    if (mySettings.debuglevel > 0) { LOG_Iln("OLED: SSD1306 allocation failed"); }
    ok = false;
  } 
  else {
    // clear the display
    display.clearDisplay();
    //Set the color - always use white despite actual display color
    display.setTextColor(WHITE);
    //Set the font size
    display.setTextSize(1.3);
    //Set the cursor coordinates
    display.setCursor(0,0);
    display.print("OLED initialized...");
    display.display();
    if (mySettings.debuglevel > 1) { LOG_Iln("OLED: initialized"); }
    ok = true;
  }

  return ok;
} 

bool updateECGDisplay() {
  bool ok;
  LOG_Dln("D:U:Disp:E:..");

  display.clearDisplay();
  display.drawBitmap(0, 4, ECG_Disp, 32, 32, 1);
  display.display();
  ok = true;
  if (mySettings.debuglevel > 1) { LOG_Iln("OLED: updated"); }

  return ok;
} 

bool updateBatteryDisplay() {
  bool ok = false;
  LOG_Dln("D:U:Disp:B:..");

  if (oled_avail) {
    display.clearDisplay();
    display.drawBitmap(0, 4, Battery_100, 32, 32, 1);
    display.setCursor(42, 0);
    display.print("ChgR:"); display.print(batteryChargerate); display.print(" %/hr");
    display.setCursor(40, 15);
    display.print("Bat:"); display.print(batteryPercent , 1); display.print(" %");
    display.display();
    ok = true;
    // This needs to be developed
    if (mySettings.debuglevel > 1) { LOG_Iln("OLED: updated"); }
  }
  else {
    if (mySettings.debuglevel > 1) { LOG_Iln("No OLED"); }
  }

  return ok;
} 

